## ZMKFirmware/fine40rev1/Kconfig.defconfig
```kconfig
if SHIELD_fine40rev1

config ZMK_KEYBOARD_NAME
    default "fine!40"

config I2C
	default y

config SSD1306
	default y
	
config SSD1306_REVERSE_MODE
	default y

if LVGL

config LVGL_HOR_RES_MAX
	default 128

config LVGL_VER_RES_MAX
	default 64

config LVGL_VDB_SIZE
	default 64

config LVGL_DPI
	default 148

config LVGL_BITS_PER_PIXEL
	default 1

choice LVGL_COLOR_DEPTH
	default LVGL_COLOR_DEPTH_1
endchoice

endif # LVGL

endif
```

## ZMKFirmware/fine40rev1/Kconfig.shield
```kconfig
# Aidan Smith (2021)
# SPDX-License-Identifier: MIT

config SHIELD_fine40rev1
	def_bool $(shields_list_contains,fine40rev1)
```
