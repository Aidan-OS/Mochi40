#include "Mochi40.h"
#define _______ KC_TRNS

#define _MAIN 0
#define _RIGHT 1
#define _LEFT 2
#define _TAB 3

#define LT3_TAB LT(_TAB, KC_TAB)

const uint16_t PROGMEM keymaps[][MATRIX_ROWS][MATRIX_COLS] = {

[_MAIN] = LAYOUT(
    KC_ESC  , KC_Q    , KC_W    , KC_E    , KC_R      , KC_T   , KC_Y       , KC_U    , KC_I    , KC_O   , KC_P     , KC_BSPC ,
    LT3_TAB , KC_A    , KC_S    , KC_D    , KC_F      , KC_G   , KC_H       , KC_J    , KC_K    , KC_L   , KC_SCLN  , KC_QUOT ,
    KC_LSFT , KC_Z    , KC_X    , KC_C    , KC_V      , KC_B   , KC_N       , KC_M    , KC_COMM , KC_DOT , KC_SLSH  , KC_ENT  ,
    KC_LCTL , KC_RALT , KC_LGUI , KC_BSLS , MO(_LEFT) , KC_SPC , MO(_RIGHT) , KC_LEFT , KC_UP   , KC_DOWN, KC_RIGHT , KC_MPLY
),

[_LEFT] = LAYOUT( /* LEFT */
  KC_GRV  , KC_1    , KC_2    , KC_3    , KC_4    , KC_5    , KC_6    , KC_7          , KC_8    , KC_9                , KC_0                 , KC_DELETE ,
  _______ , _______ , _______ , _______ , _______ , _______ , _______ , KC_UNDERSCORE , KC_PLUS , KC_LEFT_CURLY_BRACE , KC_RIGHT_CURLY_BRACE , _______   ,
  _______ , _______ , _______ , _______ , _______ , _______ , _______ , _______       , _______ , _______             , _______              , _______   ,
  _______ , _______ , _______ , _______ , _______ , _______ , _______ , KC_HOME       , KC_PGDN , KC_PGUP             , KC_END               , _______
),

[_RIGHT] = LAYOUT( /* RIGHT */
  KC_TILDE , KC_EXCLAIM , KC_AT   , KC_HASH , KC_DOLLAR , KC_PERCENT , KC_CIRCUMFLEX , KC_AMPERSAND , KC_ASTERISK , KC_LEFT_PAREN , KC_RIGHT_PAREN , KC_DELETE ,
  _______  , _______    , _______ , _______ , _______   , _______    , _______       , KC_MINS      , KC_EQL      , KC_LBRC       , KC_RBRC        , _______   ,
  _______  , _______    , _______ , _______ , _______   , _______    , _______       , _______      , KC_LT       , KC_GT         , _______        , _______   ,
  _______  , _______    , _______ , _______ , _______   , _______    , _______       , KC_MUTE      , KC_VOLD     , KC_VOLU       , KC_MPLY        , _______
),

[_TAB] = LAYOUT( /* Tab */
  KC_ESC  , RESET   , _______ , _______ , _______ , _______ , _______ , _______ , _______ , _______ , _______ , _______ ,
  _______ , KC_F11  , KC_F12  , KC_F13  , KC_F14  , KC_F15  , KC_F16  , KC_F17  , KC_F18  , KC_F19  , KC_F20  , _______ ,
  _______ , KC_F1   , KC_F2   , KC_F3   , KC_F4   , KC_F5   , KC_F6   , KC_F7   , KC_F8   , KC_F9   , KC_F10  , _______ ,
  _______ , _______ , _______ , _______ , _______ , _______ , _______ , KC_MS_L , KC_MS_D , KC_MS_U , KC_MS_R , _______
),
};

#ifdef OLED_ENABLE
//static void render_logo(void) {
//    static const char PROGMEM raw_logo[] = {
//        0,  0,  0,  0,  0,  0,  0,  0,  0,  0,  0,  0,  0,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  0,
//        0,  0,  0,  0,  0,  0,  0,128,192,224,240,248,252,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  0, 
//        0,  0,  0,  0,192,248,254,255,255,255,255,255,255,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  0, 
//        0,  0,  0,  0,255,255,255,255,255,255,255,255,255,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  0, 
//        0,  0,  0,  0,255,255,255,255,255,255,255,255,255,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  0, 
//        0,  0,  0,  0,  1, 15, 63,255,255,255,255,255,255,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  0, 
//        0,  0,  0,  0,  0,  0,  0,  0,  1,  3,  7, 15, 31,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  0, 
//        0,  0,  0,  0,  0,  0,  0,  0,  0,  0,  0,  0,  0,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  0,
//    };
//    oled_write_raw_P(raw_logo, sizeof(raw_logo));
//}

static void render_mochi(void)
{
	static const char PROGMEM mochi_logo[] = {
		0,  0,  0,  0,  0,224,224,224,224,224,224,  0,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  0,
		0,  0,  0,  0,  0,  0, 15,255,255,255,255,248,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  0, 
		0,  0,  0,  0,  0,  0,  0,  0, 15,127,255,255,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  0, 
		0,  0,  0,  0,  0,  0,  0,  0,  0,  0,  1,  1,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  0,
	};
	
	oled_write_raw_P(mochi_logo, sizeof(mochi_logo));
}


oled_rotation_t oled_init_user(oled_rotation_t rotation) {
       return OLED_ROTATION_180;  // flips the display 180 degrees
}
void oled_task_user(void) {
	render_mochi();
	oled_set_cursor(0, 4);
	oled_write_P(PSTR("Layer: "), false);
	
	switch(get_highest_layer(layer_state))
	{
		case _MAIN:
			oled_write_ln_P(PSTR("Main"), false);
			break;
		case _LEFT:
			oled_write_ln_P(PSTR("Left"), false);
			break;
		case _RIGHT:
			oled_write_ln_P(PSTR("Right"), false);
			break;
		case _TAB:
			oled_write_ln_P(PSTR("Tab"), false);
			break;
	}
	
	//render_logo();
}
#endif

#ifdef ENCODER_ENABLE
bool encoder_update_user(uint8_t index, bool clockwise) {
	// Volume control
	if (clockwise) {
		tap_code(KC_VOLU);
	} else {
		tap_code(KC_VOLD);
	}
	return false;
}
#endif

const macro_t *action_get_macro(keyrecord_t *record, uint8_t id, uint8_t opt) {
	// keyevent_t event = record->event;

	switch (id) {

	}
	return MACRO_NONE;
}

void matrix_init_user(void) {
}

void matrix_scan_user(void) {
}

bool process_record_user(uint16_t keycode, keyrecord_t *record) {
	return true;
}

void led_set_user(uint8_t usb_led) {

	if (usb_led & (1 << USB_LED_NUM_LOCK)) {

	} else {

	}

	if (usb_led & (1 << USB_LED_CAPS_LOCK)) {

	} else {

	}

	if (usb_led & (1 << USB_LED_SCROLL_LOCK)) {

	} else {

	}

	if (usb_led & (1 << USB_LED_COMPOSE)) {

	} else {

	}

	if (usb_led & (1 << USB_LED_KANA)) {

	} else {

	}

}
